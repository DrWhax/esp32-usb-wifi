## main/Kconfig.projbuild
```kconfig
menu "Example Configuration"

    config ESP_WIFI_SSID
        string "WiFi SSID"
        default "myssid"
        help
            SSID (network name) for the example to connect to.

    config ESP_WIFI_PASSWORD
        string "WiFi Password"
        default "mypassword"
        help
            WiFi password (WPA or WPA2) for the example to use.

    config BRIDGE_LED_GPIO
        int "Status LED (WS2812) GPIO"
        default 48
        help
            Data pin of the devkit's WS2812 status LED. 48 on
            ESP32-S3-DevKitC-1 v1.0, 38 on v1.1. The firmware runs fine
            if no LED is attached.

endmenu
```

## sdkconfig.defaults
```kconfig
CONFIG_TINYUSB_NET_MODE_NCM=y
CONFIG_TINYUSB_CDC_ENABLED=y
CONFIG_TINYUSB_CDC_COUNT=1
CONFIG_ESP_TASK_WDT_PANIC=y
CONFIG_FREERTOS_HZ=1000
CONFIG_ESP_WIFI_STATIC_RX_BUFFER_NUM=16
CONFIG_ESP_WIFI_DYNAMIC_RX_BUFFER_NUM=64
CONFIG_ESP_WIFI_DYNAMIC_TX_BUFFER_NUM=64
CONFIG_TINYUSB_NCM_OUT_NTB_BUFFS_COUNT=4
CONFIG_TINYUSB_NCM_IN_NTB_BUFFS_COUNT=4
CONFIG_TINYUSB_NCM_OUT_NTB_BUFF_MAX_SIZE=10240
CONFIG_TINYUSB_NCM_IN_NTB_BUFF_MAX_SIZE=10240
```
